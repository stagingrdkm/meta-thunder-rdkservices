## conf/layer.conf
```bitbake
# We have a conf and classes directory, append to BBPATH
BBPATH .= ":${LAYERDIR}"

# We have a recipes directory, add to BBFILES
BBFILES += "${LAYERDIR}/recipes-*/*.bb ${LAYERDIR}/recipes-*/*.bbappend"
BBFILES += "${LAYERDIR}/recipes-*/thunderclientlibraries/*.bb ${LAYERDIR}/recipes-*/thunderclientlibraries/*.bbappend"
BBFILES += "${LAYERDIR}/recipes-core/packagegroups/*.bb"
BBFILES += "${LAYERDIR}/recipes-core/images/*.bbappend"

BBFILES += "${LAYERDIR}/recipes-netflix/netflix/*.bbappend"

BBFILE_COLLECTIONS += "meta-thunder-rdkservices"
BBFILE_PATTERN_meta-thunder-rdkservices := "^${LAYERDIR}/"
BBFILE_PRIORITY_meta-thunder-rdkservices = "102"

BBMASK .= "|meta-rdk-video/recipes-extended/rdkservices"
BBMASK .= "|meta-rdk-video/recipes-extended/rdkservices-next"

BBMASK .= "|meta-rdk-next/recipes-extended/rdkservices/"

# mask original receipe come from: https://code.rdkcentral.com/r/collaboration/comcast-lgi/rdk/yocto_oe/layers/meta-rdk-video (topic/wpe_r4 branch)
# but keep that here at least for the reference
BBMASK .= "|recipes-thunder/rdkservices_.*\.bb"

# mask orginal receipe
BBMASK .= "|meta-lgi-wpe/recipes-wpe/meta-rdk-ext/webkitbrowser-plugin/webkitbrowser-plugin_git\.bbappend"

# mask LGI specific receipes and bbappends made elsewhere (not sure about that particular plugin location)
BBMASK .= "|meta-rdk/recipes-extended/webkitbrowser-plugin/webkitbrowser-plugin_git.bb"
BBMASK .= "|meta-lgi-wpe/recipes-wpe/meta-rdk-next/webkitbrowser-plugin/webkitbrowser-plugin_git\.bb"
```
